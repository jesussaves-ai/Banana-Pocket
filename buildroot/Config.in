## buildroot/Config.in
```kconfig
menu "Banana"
source "$BR2_EXTERNAL_BANANA_PATH/package/banana-ui/Config.in"
source "$BR2_EXTERNAL_BANANA_PATH/package/bananad/Config.in"
source "$BR2_EXTERNAL_BANANA_PATH/package/banana-tube/Config.in"
source "$BR2_EXTERNAL_BANANA_PATH/package/yt-dlp/Config.in"
source "$BR2_EXTERNAL_BANANA_PATH/package/dolphin/Config.in"
source "$BR2_EXTERNAL_BANANA_PATH/package/portmaster/Config.in"
source "$BR2_EXTERNAL_BANANA_PATH/package/libudev-zero/Config.in"
source "$BR2_EXTERNAL_BANANA_PATH/package/retroarch/Config.in"
endmenu
```

## buildroot/package/alsa-ucm-conf/Config.in
```kconfig
config BR2_PACKAGE_ALSA_UCM_CONF
	bool "alsa-ucm-conf"
	help
	  ALSA Use Case Manager configuration (and topologies): the ucm2 tree, which an opener that speaks UCM
	  (alsaucm, PipeWire's ACP) reads to set a card's routing and levels. Banana needs it for the RPC's card
	  (a UCM2 profile in the rootfs overlay), so ACP can bring the AudioReach card up itself.
	  https://www.alsa-project.org/
```

## buildroot/package/dolphin/Config.in
```kconfig
config BR2_PACKAGE_DOLPHIN
	bool "dolphin"
	depends on BR2_INSTALL_LIBSTDCPP
	depends on BR2_TOOLCHAIN_HAS_THREADS
	depends on BR2_PACKAGE_HAS_LIBEGL && BR2_PACKAGE_HAS_LIBGLES && BR2_PACKAGE_HAS_LIBGBM
	# the udev virtual (Dolphin's evdev backend enumerates pads through libudev); the provider is chosen in the
	# defconfig, the way every Buildroot package that needs udev does it
	depends on BR2_PACKAGE_HAS_UDEV
	select BR2_PACKAGE_ALSA_LIB
	select BR2_PACKAGE_LIBDRM
	select BR2_PACKAGE_LIBEVDEV
	select BR2_PACKAGE_LIBPNG
	select BR2_PACKAGE_VULKAN_LOADER
	select BR2_PACKAGE_WAYLAND
	select BR2_PACKAGE_WAYLAND_PROTOCOLS
	select BR2_PACKAGE_ZLIB
	help
	  Dolphin, the GameCube and Wii emulator, in its nogui frontend
	  (no Qt): a game is launched from the command line and configured
	  through the INI files beside it, which is how Banana's Wii
	  launcher drives it. It renders on the panel's GPU through EGL or
	  Vulkan, plays under cage (the Wayland kiosk compositor) so the
	  panel's orientation is applied, and takes its input from the
	  handheld's evdev gamepad.

comment "dolphin needs a libEGL/libGLES/libGBM provider and a udev provider"
	depends on !(BR2_PACKAGE_HAS_LIBEGL && BR2_PACKAGE_HAS_LIBGLES && BR2_PACKAGE_HAS_LIBGBM && BR2_PACKAGE_HAS_UDEV)
```

## buildroot/package/yt-dlp/Config.in
```kconfig
config BR2_PACKAGE_YT_DLP
	bool "yt-dlp"
	depends on BR2_PACKAGE_PYTHON3
	select BR2_PACKAGE_FFMPEG
	help
	  yt-dlp: the maintained fork of youtube-dl, installed as its official self-contained Python zipapp. Its
	  Python runtime (with the ssl and zlib modules) and ffmpeg for the audio/video mux come from the image.

	  https://github.com/yt-dlp/yt-dlp
```
